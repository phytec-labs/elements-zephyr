## dts/bindings/spi/spi-controller.yaml
```yaml
# Copyright (c) 2018, I-SENSE group of ICCS
# SPDX-License-Identifier: Apache-2.0

# Common fields for SPI controllers

include: base.yaml

bus: spi

properties:
    clock-frequency:
      type: int
      required: false
      description: Clock frequency the SPI peripheral is being driven at
    label:
      required: true
    cs-gpios:
      type: phandle-array
      required: false
```
